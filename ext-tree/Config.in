## ext-tree/configs/dvaemu-emu_arm_vexpress_defconfig
```kconfig
BR2_arm=y
BR2_cortex_a9=y
BR2_ARM_EABIHF=y
BR2_ARM_ENABLE_NEON=y
BR2_ARM_FPU_VFPV3D16=y
BR2_DEFCONFIG="$(CONFIG_DIR)/defconfig"
BR2_CCACHE=y
BR2_DEPRECATED=y
BR2_ENABLE_DEBUG=y
BR2_STRIP_none=y
BR2_OPTIMIZE_0=y
BR2_GLOBAL_PATCH_DIR="$(BR2_EXTERNAL)/patches"
BR2_KERNEL_HEADERS_3_4=y
BR2_UCLIBC_CONFIG="$(TOPDIR)/../buildroot-armv7/ext-tree/configs/uClibc-0.9.33.config"
BR2_TOOLCHAIN_BUILDROOT_LARGEFILE=y
BR2_TOOLCHAIN_BUILDROOT_WCHAR=y
BR2_PTHREAD_DEBUG=y
BR2_BINUTILS_VERSION_2_24=y
BR2_GCC_VERSION_4_8_X=y
BR2_TOOLCHAIN_BUILDROOT_CXX=y
BR2_PACKAGE_HOST_GDB=y
BR2_TARGET_GENERIC_GETTY_PORT="ttyAMA0"
BR2_ROOTFS_OVERLAY="$(TOPDIR)/../buildroot-armv7/ext-tree/board/dvaemu/overlay"
BR2_ROOTFS_POST_BUILD_SCRIPT="$(TOPDIR)/../buildroot-armv7/ext-tree/board/dvaemu/post-build.sh"
BR2_LINUX_KERNEL=y
BR2_LINUX_KERNEL_CUSTOM_TARBALL=y
BR2_LINUX_KERNEL_CUSTOM_TARBALL_LOCATION="file://$(TOPDIR)/../download/linux-3.4.11-rt19.tar.gz"
BR2_LINUX_KERNEL_USE_CUSTOM_CONFIG=y
BR2_LINUX_KERNEL_CUSTOM_CONFIG_FILE="$(TOPDIR)/../buildroot-armv7/ext-tree/board/dvaemu/kernel-defconfig"
BR2_LINUX_KERNEL_ZIMAGE=y
BR2_LINUX_KERNEL_DTS_SUPPORT=y
BR2_LINUX_KERNEL_INTREE_DTS_NAME="vexpress-v2p-ca9"
BR2_LINUX_KERNEL_INSTALL_TARGET=y
BR2_PACKAGE_BZIP2=y
BR2_PACKAGE_XZ=y
BR2_PACKAGE_GDB=y
BR2_PACKAGE_GDB_SERVER=y
BR2_PACKAGE_GDB_DEBUGGER=y
BR2_PACKAGE_LTRACE=y
BR2_PACKAGE_STRACE=y
BR2_PACKAGE_BINUTILS=y
BR2_PACKAGE_BINUTILS_TARGET=y
BR2_PACKAGE_FLEX=y
BR2_PACKAGE_LIBTOOL=y
BR2_PACKAGE_MAKE=y
BR2_PACKAGE_PKGCONF=y
BR2_PACKAGE_TREE=y
BR2_PACKAGE_MTD=y
BR2_PACKAGE_MTD_MKFSJFFS2=y
BR2_PACKAGE_PERL=y
BR2_PACKAGE_PHP=y
BR2_PACKAGE_LIBGCRYPT=y
BR2_PACKAGE_EXPAT=y
BR2_PACKAGE_LIBROXML=y
BR2_PACKAGE_LIBXML2=y
BR2_PACKAGE_MXML=y
BR2_PACKAGE_DHCPCD=y
BR2_PACKAGE_DHCPDUMP=y
BR2_PACKAGE_DROPBEAR=y
BR2_PACKAGE_GESFTPSERVER=y
BR2_PACKAGE_IPUTILS=y
BR2_PACKAGE_NCFTP=y
BR2_PACKAGE_NETSTAT_NAT=y
BR2_PACKAGE_NGREP=y
BR2_PACKAGE_RSH_REDONE=y
BR2_PACKAGE_RSH_REDONE_RLOGIN=y
BR2_PACKAGE_RSH_REDONE_RSH=y
BR2_PACKAGE_RSYNC=y
BR2_PACKAGE_SOCAT=y
BR2_PACKAGE_FILE=y
BR2_PACKAGE_SUDO=y
BR2_TARGET_ROOTFS_EXT2=y
BR2_TARGET_ROOTFS_EXT2_BLOCKS=1048576
# BR2_TARGET_ROOTFS_TAR is not set
BR2_PACKAGE_HOST_MTD=y
BR2_PACKAGE_KLISH=y
```
